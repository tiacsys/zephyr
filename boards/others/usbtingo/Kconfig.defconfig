## boards/others/usbtingo/Kconfig.defconfig
```kconfig
# USBtingo board

# SPDX-FileCopyrightText: Copyright (c) 2026 Navimatix GmbH
# SPDX-FileCopyrightText: Copyright (c) 2026 TiaC Systems
# SPDX-License-Identifier: Apache-2.0

if BOARD_USBTINGO

if BOOTLOADER_MCUBOOT
choice MCUBOOT_BOOTLOADER_MODE
	# Board only supports MCUBoot via "upgrade only" method:
	default MCUBOOT_BOOTLOADER_MODE_OVERWRITE_ONLY
endchoice
endif #BOOTLOADER_MCUBOOT

endif # BOARD_USBTINGO
```

## boards/others/usbtingo/Kconfig.sysbuild
```kconfig
# SPDX-FileCopyrightText: Copyright (c) 2026 Navimatix GmbH
# SPDX-FileCopyrightText: Copyright (c) 2026 TiaC Systems
# SPDX-License-Identifier: Apache-2.0

choice MCUBOOT_MODE
	default MCUBOOT_MODE_OVERWRITE_ONLY
endchoice
```

## boards/others/usbtingo/Kconfig.usbtingo
```kconfig
# SPDX-FileCopyrightText: Copyright (c) 2026 Navimatix GmbH
# SPDX-FileCopyrightText: Copyright (c) 2026 TiaC Systems
# SPDX-License-Identifier: Apache-2.0

config BOARD_USBTINGO
	select SOC_LPC5514
	select SOC_PART_NUMBER_LPC5514JBD64
```

## boards/others/usbtingo/board.yml
```yaml
# SPDX-FileCopyrightText: Copyright (c) 2026 Navimatix GmbH
# SPDX-FileCopyrightText: Copyright (c) 2026 TiaC Systems
# SPDX-License-Identifier: Apache-2.0

board:
  name: usbtingo
  full_name: USBtingo
  vendor: others
  socs:
    - name: lpc5514
```

## boards/others/usbtingo/usbtingo_defconfig
```kconfig
# SPDX-FileCopyrightText: Copyright (c) 2026 Navimatix GmbH
# SPDX-FileCopyrightText: Copyright (c) 2026 TiaC Systems
# SPDX-License-Identifier: Apache-2.0

CONFIG_ARM_MPU=y
CONFIG_RUNTIME_NMI=y
CONFIG_GPIO=y
CONFIG_GPIO_HOGS=y
```

## drivers/charger/Kconfig.bq25713
```kconfig
# Copyright 2025 Palta Tech, S.A
#
# SPDX-License-Identifier: Apache-2.0

config CHARGER_BQ25713
	bool "BQ25713 Battery Charger"
	default y
	depends on DT_HAS_TI_BQ25713_ENABLED
	#Check if this works
	select I2C if $(dt_compat_on_bus,$(DT_COMPAT_TI_BQ25713),i2c)
	select SMBUS if $(dt_compat_on_bus,$(DT_COMPAT_TI_BQ25713),smbus)
	help
	  Enable BQ25713 battery charger driver.
```

## drivers/charger/Kconfig.bq2571x
```kconfig
# Copyright 2025 Palta Tech, S.A
#
# SPDX-License-Identifier: Apache-2.0

config CHARGER_BQ2571X
	bool "BQ2571X Battery Charger"
	default y
	depends on DT_HAS_TI_BQ2571X_ENABLED
	#Check if this works
	select I2C if $(dt_compat_on_bus,$(DT_COMPAT_TI_BQ2571X),i2c)
	select SMBUS if $(dt_compat_on_bus,$(DT_COMPAT_TI_BQ2571X),smbus)
	help
	  Enable BQ2571X battery charger driver.
```

## drivers/counter/Kconfig.counter_emul
```kconfig
# Copyright (c) 2024 Navimatix GmbH
# SPDX-License-Identifier: Apache-2.0

config COUNTER_EMUL
	bool "Counter emulation driver"
	def_bool y
	depends on DT_HAS_ZEPHYR_COUNTER_EMUL_ENABLED
```

## drivers/counter/Kconfig.rpi_pico_pit
```kconfig
# Copyright (c) 2023 TOKITA Hiroshi
# SPDX-License-Identifier: Apache-2.0

config COUNTER_PIT_RPI_PICO
	bool "RPI Pico pit driver"
	def_bool y
	depends on PWM
	depends on DT_HAS_RASPBERRYPI_PICO_PIT_CHANNEL_ENABLED
```

## drivers/stepper/Kconfig
```kconfig
# SPDX-FileCopyrightText: Copyright (c) 2023 Carl Zeiss Meditec AG
# SPDX-License-Identifier: Apache-2.0

menuconfig STEPPER
	bool "Stepper Controller"
	help
	  Enable stepper controller

if STEPPER

module = STEPPER
module-str = stepper
source "subsys/logging/Kconfig.template.log_config"

config STEPPER_INIT_PRIORITY
	int "Stepper Motor Controller init priority"
	default 90
	help
	  Stepper motor controller initialization priority.

config STEPPER_SHELL
	bool "Stepper shell"
	depends on SHELL
	help
	  Enable stepper shell for testing.

config STEPPER_CONTROLLER_ISR_SAFE_EVENTS
	bool "Guarantee that callbacks are executed in a non-ISR environment"
	help
	  Enable the dispatch of stepper_ctrl generated events via
	  a message queue to guarantee that the event handler
	  code is not run inside of an ISR. Can be disabled, but
	  then registered stepper_ctrl event callbacks might run inside an ISR.

config STEPPER_CONTROLLER_EVENT_QUEUE_LEN
	int "Maximum number of pending stepper_ctrl events"
	default 4
	depends on STEPPER_CONTROLLER_ISR_SAFE_EVENTS
	help
	  The maximum number of stepper_ctrl events per driver instance that can
	  be pending before new events are dropped.

comment "Stepper Drivers"

# zephyr-keep-sorted-start
rsource "Kconfig.fake"
rsource "adi_tmc/Kconfig"
rsource "allegro/Kconfig"
rsource "common/Kconfig"
rsource "gpio_stepper/Kconfig"
rsource "step_dir/Kconfig"
rsource "ti/Kconfig"
# zephyr-keep-sorted-stop

endif
```

## drivers/stepper/Kconfig.drv8424
```kconfig
# SPDX-FileCopyrightText: Copyright (c) 2024 TiaC Systems
# SPDX-License-Identifier: Apache-2.0

config DRV8424
	bool "TI DRV8424 stepper motor driver"
	default y
	depends on DT_HAS_TI_DRV8424_ENABLED
	depends on COUNTER
	select STEP_DIR_STEPPER
	select STEP_DIR_STEPPER_COUNTER
	help
	  Enable driver for TI DRV8424 stepper motor driver.
```

## drivers/stepper/Kconfig.drv8424_accel
```kconfig
# SPDX-FileCopyrightText: Copyright (c) 2024 Navimatix GmbH
# SPDX-License-Identifier: Apache-2.0

config DRV8424_ACCEL
	bool "TI DRV8424 stepper motor driver with acceleration"
	default y
	depends on DT_HAS_TI_DRV8424_ACCEL_ENABLED
	select COUNTER
	help
	  Enable driver for TI DRV8424 stepper motor driver with acceleration.

if DRV8424_ACCEL

config HEAP_MEM_POOL_ADD_SIZE_DRV8424_ACCEL
	int
	default 128 # Enough for 5 pending events

endif # DRV8424
```

## drivers/stepper/Kconfig.step_dir
```kconfig
# SPDX-FileCopyrightText: Copyright (c) 2024 TiaC Systems
# SPDX-License-Identifier: Apache-2.0

config STEP_DIR_STEPPER
	bool "Enable step/dir stepper interface"

config STEP_DIR_STEPPER_COUNTER
	bool "Enable counter based step/dir interface"
	depends on STEP_DIR_STEPPER

if STEP_DIR_STEPPER

config HEAP_MEM_POOL_ADD_SIZE_STEP_DIR_STEPPER
	int
	default 128 # Enough for 5 pending events

endif # STEP_DIR_STEPPER
```

## drivers/stepper/accel_controller/Kconfig
```kconfig
# Copyright (c) 2026 Navimatix GmbH
# SPDX-License-Identifier: Apache-2.0

if STEPPER

rsource "Kconfig.zephyr_accel_controller"

endif # STEPPER
```

## drivers/stepper/accel_controller/Kconfig.zephyr_accel_controller
```kconfig
# Copyright (c) 2026 Navimatix GmbH
# SPDX-License-Identifier: Apache-2.0

config ZEPHYR_ACCEL_CONTROLLER
	bool "Acceleration Controller for motion controllers"
	default y
	depends on DT_HAS_ZEPHYR_ACCEL_CONTROLLER_ENABLED
	help
	  Enable driver for czag acceleration motion controller.

if ZEPHYR_ACCEL_CONTROLLER

config ZEPHYR_ACCEL_CONTROLLER_WORK_QUEUE_STACK_SIZE
        int
        default 1024
	help
	  Recommended size: 1024 x Number of driver instances


endif # ZEPHYR_ACCEL_CONTROLLER
```

## drivers/stepper/common/Kconfig
```kconfig
# Copyright (c) 2026 Navimatix GmbH
# SPDX-License-Identifier: Apache-2.0

config STEPPER_CONTROLLER_EVENT_COMMON
	bool
	help
	  Enable library used for handling stepper_ctrl event callbacks.
```

## drivers/stepper/event_handler/Kconfig
```kconfig
# Copyright (c) 2026 Navimatix GmbH
# SPDX-License-Identifier: Apache-2.0

config STEPPER_CTRL_EVENT_HANDLER
	bool
	help
	  Enable library used for handling stepper_ctrl event callbacks.

if STEPPER_CTRL_EVENT_HANDLER

config STEPPER_CTRL_ISR_SAFE_EVENTS
	bool "Guarantee that callbacks are executed in a non-ISR context"
	help
	  Registered callbacks for stepper_ctrl events are executed via work
	  queue, guaranteeing that they run in a non-ISR context. Multiple
	  events can be pending and are processed sequentially.

config STEPPER_CTRL_EVENT_QUEUE_LEN
	int "Maximum number of pending stepper_ctrl events"
	default 4
	depends on STEPPER_CTRL_ISR_SAFE_EVENTS
	help
	  The maximum number of stepper_ctrl events per driver instance that can
	  be pending before new events are dropped.

endif # STEPPER_CTRL_EVENT_HANDLER
```

## dts/bindings/charger/ti,bq25710.yaml
```yaml
# Copyright 2025 Navimatix GmbH
# SPDX-License-Identifier: Apache-2.0

description: |
  BQ25710 SMBus battery charge controller IC.

  BQ25710 targets 1s to 4s Cell, USB Power Delivery/Adapter Charger with
  Narrow VDC Power Path Management and Processor Hot Monitor

  This charger is represented by device tree child node, e.g:

  charger: bq25710@12 {
      compatible = "ti,bq2571x";
      reg = <0x12>;
      status = "okay";

      constant-charge-current-max-microamp = <1000000>;
      constant-charge-voltage-max-microvolt = <3800000>;
      system-voltage-min-threshold-microvolt = <3328000>;
  };

include: [smbus-device.yaml, "ti,bq2571x_base.yaml"]

compatible: "ti,bq2571x"
```

## dts/bindings/charger/ti,bq25713.yaml
```yaml
# Copyright 2025 Palta Tech, S.A
# SPDX-License-Identifier: Apache-2.0

description: |
  BQ25713 I2C battery charge controller IC.

  BQ25713 targets 1s to 4s Cell, USB Power Delivery/Adapter Charger with
  Narrow VDC Power Path Management and Processor Hot Monitor

  This charger is represented by device tree child node, e.g:

  charger: bq25713@6b {
      compatible = "ti,bq2571x";
      reg = <0x6b>;
      status = "okay";

      constant-charge-current-max-microamp = <1000000>;
      constant-charge-voltage-max-microvolt = <3800000>;
      system-voltage-min-threshold-microvolt = <3328000>;
  };

include: [i2c-device.yaml, "ti,bq2571x_base.yaml"]

compatible: "ti,bq2571x"
```

## dts/bindings/charger/ti,bq25713_base.yaml
```yaml
# Copyright 2025 Palta Tech, S.A
# SPDX-License-Identifier: Apache-2.0

description: |
  Common properties for the BQ25710 and BQ25713 battery charge controller IC.

include: battery.yaml

properties:
  constant-charge-current-max-microamp:
    required: true
    description: |
      The charge current target for the constant current phase of the charge profile.
      This value will be set at initialization time. Range: 0 mA to 8.128 A.
      The value specified will be rounded down to the closest implemented value.

  constant-charge-voltage-max-microvolt:
    required: true
    description: |
      The voltage regulation target for the constant voltage phase of the battery charging profile.
      This value will be set at initialization time. Range: 4.2 V 1S to 16.8 V 4S.
      The value specified will be rounded down to the closest implemented value.

  system-voltage-min-threshold-microvolt:
    type: int
    required: true
    description: |
      Minimum system voltage.
      Voltage that will be set above when the system voltage drops this level.
      This value will be set at initialization time. Range: 1.024 V to 16.128 V.
      The value specified will be rounded down to the closest implemented value.
```

## dts/bindings/counter/raspberrypi,pico-pit_channel.yaml
```yaml
# Copyright (c) 2024 Navimatix GmbH
# SPDX-License-Identifier: Apache-2.0

description: Raspberry Pi Pico PIT

compatible: "raspberrypi,pico-pit-channel"

include: base.yaml

properties:
  pwm_slice:
    required: true
    type: int
    description: PWM Slice used by the counter (value 0-7). Using other pwm devices connected to this slice leads to undefined behavior.

  pwm:
    required: true
    type: phandle
    description: PWM device of the rpi pico, by default it should be "pwm".

  
```

## dts/bindings/counter/raspberrypi,pico-pit_controller.yaml
```yaml
# Copyright (c) 2021, Yonatan Schachter
# SPDX-License-Identifier: Apache-2.0

description: Raspberry Pi Pico PIT

compatible: "raspberrypi,pico-pit-controller"

include: base.yaml

properties:

  pwm:
    required: true
    type: phandle
    description: PWM device of the rpi pico, by default it should be "pwm".

  
```

## dts/bindings/counter/zephyr,counter-emul.yaml
```yaml
# Copyright (c) 2024 Navimatix GmbH
# SPDX-License-Identifier: Apache-2.0

description: |
  Emulated Counter using Kernel Timers
  Designed for testing in emulations such as native_sim and qemu
  WARNING: because of the usage of the kernel timers, accuracy can
  not be guaranteed

compatible: "zephyr,counter-emul"

include: base.yaml

properties:
  counting-down:
    type: boolean
    description: If the counter counts up or down
```

## dts/bindings/dma/altr,msgdma.yaml
```yaml
# Copyright (c) 2021 Linaro Limited
# SPDX-License-Identifier: Apache-2.0

description: Altera mSGDMA (Modular Scatter-Gather DMA)

compatible: "altr,msgdma"

include: dma-controller.yaml

properties:
    reg:
      required: true

    reg-names:
      required: true

    interrupts:
      required: true

    "#dma-cells":
      const: 0

    max-xfer-byte:
      type: int
      required: true
      description: Maximum transfer length (in bytes).
      enum:
        - 1024
        - 2048
        - 4096
        - 8192
        - 16384
        - 32768
        - 65536
        - 131072
        - 262144
        - 524288
        - 1048576
        - 2097152
        - 4194304
        - 8388608
        - 16777216
        - 33554432
        - 67108864
        - 134217728
        - 268435456
        - 536870912
        - 1073741824
        - 2147483648

    desc-fifo-depth:
      type: int
      required: true
      description: FIFO size to store descriptor count (in bytes).
      enum:
        - 8
        - 16
        - 32
        - 64
        - 128
        - 256
        - 512
        - 1024

    data-fifo-depth:
      type: int
      required: true
      description: Depth of internal data path FIFO (in bytes).
      enum:
        - 16
        - 32
        - 64
        - 128
        - 256
        - 512
        - 1024
        - 2048
        - 4096

    data-width:
      type: int
      required: true
      description: Data path width (in bytes).
      enum:
        - 8
        - 16
        - 32
        - 64
        - 128
        - 256
        - 512
        - 1024

    max-burst-count:
      type: int
      required: true
      description: Maximum burst count (in bytes).
      enum:
        - 2
        - 4
        - 8
        - 16
        - 32
        - 64
        - 128
        - 256
        - 512
        - 1024

    max-stride-words:
      type: int
      default: 1
      required: false
      description: Maximum stride amount (in words).

    response-port:
      type: int
      default: 2
      required: false
      description: |
        The response port can be set to 0 - memory-mapped,
        1 - streaming, or 2 - disabled.
      enum:
        - 0
        - 1
        - 2

    burst:
      type: boolean
      required: false
      description: Enable burst transfer support.

    burst-wrapping:
      type: boolean
      required: false
      description: Enable burst line wrapping support.

    burst-programming:
      type: boolean
      required: false
      description: Enable dynamic burst programming support.

    stride-addressing:
      type: boolean
      required: false
      description: |
        Stride addressing allows the mSGDMA to read or write data that
        is interleaved in memory. Stride addressing cannot be enabled
        if the burst transfer option is enabled.

    extended-features:
      type: boolean
      required: false
      description: |
        In order to use stride addressing, programmable burst lengths,
        64-bit addressing, or descriptor tagging the extended features
        must be supported.

    pre-fetching:
      type: boolean
      required: false
      description: |
        There is a prefetcher modules, a hardware core which fetches
        descriptors from memory if true; otherwise, multiple blocks
        have to configure by the firmware one by one.
```

## dts/bindings/misc/altr,sysid.yaml
```yaml
description: Altera Avalon System ID

compatible: "altr,sysid"

include: base.yaml

properties:
    reg:
      required: true

    label:
      required: true

    system-id:
      type: int
      required: true
      description: Platform designer systems unique identifier

    system-ts:
      type: int
      required: true
      description: Platform designer systems generation time
```
