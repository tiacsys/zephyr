## dts/bindings/stepper/adi/adi,tmc2130-spi-step-dir.yaml
```yaml
# SPDX-FileCopyrightText: Copyright (c) 2025 Navimatix GmbH
# SPDX-License-Identifier: Apache-2.0

description: |
  Analog Devices TMC2130 stepper motor driver.
  Implements only the Step Dir Interface with SPI driver configuration. The Standalone and
  (pure) Spi Driver Interfaces are not supported.

  Example:
  stepper_motor: tmc2130@0 {
    compatible = "adi,tmc2130-spi-step-dir";
    reg = <0>;
    spi-max-frequency = <DT_FREQ_M(1)>; /* Maximum SPI bus frequency */

    dir-gpios = <&arduino_header 14 0>; /* D8 */
    step-gpios = <&arduino_header 15 0>; /* D9 */
    en-gpios  = <&mikroe_stepper_gpios 0 GPIO_ACTIVE_LOW>; /* D8 */
    counter = <&counter2>;
    timing-source = "counter-accel";
    irun = <20>;
    ihold = <20>;
    stealth-chop-enabled;
  };

compatible: "adi,tmc2130-spi-step-dir"

include:
  - name: stepper-controller.yaml
  - name: spi-device.yaml
  - name: adi,trinamic-gconf.yaml
    property-allowlist:
      - i-scale-analog
  - name: adi,trinamic-ramp-generator.yaml
    property-allowlist:
      - ihold
      - irun


properties:
#Replace with include upstream
  iholddelay:
    type: int
    default: 15
    description: |
      Controls the number of clock cycles for motorpower down after a motion as soon as standstill
      is detected (stst=1) and TPOWERDOWN has expired. The smooth transition avoids a motor jerk upon
      power down.
      Value of 0-15, 0: instant power down, 1-15: Delay per current reduction step in multiple
      of 2^18 clock cycles

  dual-edge-step:
    type: boolean
    description: |
      If present, the stepper motor controller supports dual edge step signals.
      This means that the step signal can be toggled on both the rising and falling edge.

  stealth-chop-enabled:
    type: boolean
    description: |
      Enables stealth-chop for lower motor noise and vibrations at lower speeds. Note that some motors 
      have issues with a combination of stealth-chop and high current, forcing a reduction of irun
  
  tpwmthrs:
    type: int
    default: 500
    description: |
      Step intervalls larger than this value use stealth-chop, smaller oned do not. Note that this value is
      based on the clock of the TMC2130. Using the TMC2130s internal clock, a step interval of 11000000ns is
      equivalent to a threshold value of 511. Note that for this check is based on the theoretical
      step-interval at micro step resolution of 256. For example, doubling the micro step resolution and
      halving the step interval results in the same comparison value. TODO: rewrite, has 20bit length

  tpowerdown:
    type: int
    default: 10
    description: |
      TPOWERDOWN sets the delay time after stand still (stst) of the
      motor to motor current power down. Time range is about 0 to
      4 seconds.
      Attention: A minimum setting of 2 is required to allow
      automatic tuning of StealthChop PWM_OFS_AUTO.
      Reset Default = 10
      0…((2^8)-1) * 2^18 tCLK
```

## dts/bindings/stepper/step-dir-stepper.yaml
```yaml
# SPDX-FileCopyrightText: Copyright (c) 2024 TiaC Systems
# SPDX-License-Identifier: Apache-2.0

description: |
  Step/Dir pin based stepper motor controller.

include: stepper-controller.yaml

properties:

  step-gpios:
    required: true
    type: phandle-array
    description: Step pin.

  dir-gpios:
    required: true
    type: phandle-array
    description: Direction pin.
```

## dts/bindings/stepper/step_dir/vnd,timing-source-counter.yaml
```yaml
# SPDX-FileCopyrightText: Copyright (c) 2024 Navimatix GmbH
# SPDX-License-Identifier: Apache-2.0

description: |
  Counter based step-dir timing source


compatible: "vnd,timing-source-counter"

include:
  - name: base.yaml

properties:
  counter:
    required: true
    type: phandle
    description: Counter used for generating step-accurate pulse signals.
```

## dts/bindings/stepper/ti,drv8424-accel.yaml
```yaml
# SPDX-FileCopyrightText: Copyright (c) 2024 Navimatix GmbH
# SPDX-License-Identifier: Apache-2.0

description: |
  TI DRV8424 stepper motor driver with acceleration and deceleration in move_to/move_by.
  SAFETY:
  The counter needs to support both set_top_value functionalities: Setting a new top value and
  attaching an ISR to the turnaround.
  SAFETY:
  The step gpio pinneeds to be connected directly to the SOC GPIO controller, connecting the
  pin to a controller connected via a bus such as i2c or others will lead to undefined behaviour.

compatible: "ti,drv8424-accel"

properties:

  dir-gpios:
    required: true
    type: phandle-array
    description: Direction pin.

  step-gpios:
    required: true
    type: phandle-array
    description: Step pin, configured as gpio.

  fault-gpios:
    type: phandle-array
    description: Fault pin.

  en-gpios:
    type: phandle-array
    description: Enable pin.

  sleep-gpios:
    type: phandle-array
    description: Sleep pin (active low).

  m0-gpios:
    type: phandle-array
    description: Microstep configuration pin 0.

  m1-gpios:
    type: phandle-array
    description: Microstep configuration pin 1.

  counter:
    required: true
    type: phandle
    description: Counter used for generating step-accurate pulse signals.

  acceleration:
    required: true
    type: int
    description: |
      Stepper motor acceleration in full-steps/s, automatically gets 
      adjusted when using microsteps

include: stepper-controller.yaml
```

## dts/bindings/stepper/ti,drv8424.yaml
```yaml
# SPDX-FileCopyrightText: Copyright (c) 2024 TiaC Systems
# SPDX-License-Identifier: Apache-2.0

description: |
  TI DRV8424 stepper motor driver.

compatible: "ti,drv8424"

properties:

  dir-gpios:
    required: true
    type: phandle-array
    description: Direction pin.

  step-gpios:
    required: true
    type: phandle-array
    description: Step pin, configured as gpio.

  fault-gpios:
    type: phandle-array
    description: Fault pin.

  en-gpios:
    type: phandle-array
    description: Enable pin.

  sleep-gpios:
    type: phandle-array
    description: Sleep pin (active low).

  m0-gpios:
    type: phandle-array
    description: Microstep configuration pin 0.

  m1-gpios:
    type: phandle-array
    description: Microstep configuration pin 1.

  counter:
    required: true
    type: phandle
    description: Counter used for generating step-accurate pulse signals.

include: stepper-controller.yaml
```

## dts/bindings/stepper/zephyr,accel_controller.yaml
```yaml
# SPDX-FileCopyrightText: Copyright (c) 2026 Navimatix GmbH
# SPDX-License-Identifier: Apache-2.0

description: |
  Stepper Motion Controller that controls other motion controllers for the step signal generation.
  It offers basic acceleration functionality, allowing for the use of acceleration with motion
  controllers that do no support this functionality natively.

compatible: "zephyr,accel-controller"

properties:
  accel-time-microstep:
    type: int
    required: true
    description: |
      Time in nanoseconds to accelerate by 1 microstep/s.
  
  decel-time-microstep:
    type: int
    required: true
    description: |
      Time in nanoseconds to decelerate by 1 microstep/s.

  update-interval:
    type: int
    required: true
    description: |
      Time interval in nanoseconds with which to update step interval during
      acceleration and deceleration.
  
  stepper-ctrl:
    type: phandle
    required: true
    description: |
      Reference to a stepper motion controller device.
      This controller is used by this controller to generate stepper control signals.
  
  step-adjustment:
    type: int
    required: true
    description: |
      Gives in tenth of a percent the percentage of calculated acceleration and deceleration steps to be
      actually taken. A lower value causes faster acceleration and harsher stopping, while a higher value can
      cause extended movement at minimal speed.
      The optimal value depends on multiple factors such a SOC, used stepper motion controller, update-interval
      and more. The recommended starting value is 980 (98.0%).

examples:
  - |
    step_dir_motion_control: step_dir_motion_control {
      compatible = "zephyr,gpio-step-dir-stepper";
      step-gpios = <&gpioa 8 GPIO_ACTIVE_HIGH>;
      dir-gpios = <&gpioa 4 GPIO_ACTIVE_HIGH>;
      counter = <&counter2>;
    };

    zephyr_accel_controller: zephyr_accel_controller {
      status = "okay";
      compatible = "zephyr,accel-controller";
      stepper-ctrl = <&step_dir_motion_control>;
      accel-time-microstep = <666666>;
      update-interval = <10000000>;
      step-adjustment = <965>;
    };
```

## dts/bindings/timer/altr,interval-timer.yaml
```yaml
description: Altera Avalon Interval Timer

compatible: "altr,interval-timer"

include: base.yaml

properties:
    reg:
      required: true

    interrupts:
      required: true

    label:
      required: true

    clock-frequency:
      type: int
      required: true
      description: Clock frequency information for Timer operation
```

## samples/subsys/modbus/rtu_client/boards/can485dbv1_procpu.conf
```kconfig
# SPDX-FileCopyrightText: Copyright (c) 2026 Navimatix GmbH
# SPDX-FileCopyrightText: Copyright (c) 2026 TiaC Systems
# SPDX-License-Identifier: Apache-2.0

# This increases the ESP UART FIFO so that the maximum required Modbus RTU
# frame size of 256 bytes can fit in it. The uC/Modbus subsystem in Zephyr
# doesn't support fragmentation or defragmentation of singel Modbus RTU
# messages, thus the UART must guarantee that Modbus RTU messages can be
# sent and received at once and in their entirety.
CONFIG_UART_ESP32_TX_FIFO_THRESH=0x127
CONFIG_UART_ESP32_RX_FIFO_THRESH=0x127
```

## tests/drivers/counter/counter_emul/testcase.yaml
```yaml
# Copyright (c) 2024 Navimatix GmbH
# SPDX-License-Identifier: Apache-2.0

tests:
  drivers.counter.counter_emul:
    tags:
      - drivers
      - counter
      - api
      - emulation
    depends_on: counter
    min_ram: 16
    platform_allow:
      - qemu_cortex_m0
    timeout: 600
```

## tests/drivers/counter/rpi_pico_pit/testcase.yaml
```yaml
# Copyright (c) 2024 Navimatix GmbH
# SPDX-License-Identifier: Apache-2.0

tests:
  drivers.counter.rpi_pico_pit:
    tags:
      - drivers
      - counter
      - api
      - pwm
    depends_on: counter
    min_ram: 16
    platform_allow:
      - cytron_maker_pi_rp2040
      - rpi_pico
    timeout: 600
```

## tests/drivers/i2c/i2c_slave_api/testcase.yaml
```yaml
common:
  depends_on: i2c
  tags: drivers i2c

tests:
  drivers.i2c_slave:
    harness: ztest
    harness_config:
      fixture: i2c_bus_short
  drivers.i2c_slave.dual_role:
    platform_allow: nucleo_f091rc stm32f072b_disco nucleo_g071rb
    extra_configs:
      - CONFIG_APP_DUAL_ROLE_I2C=y
```

## tests/drivers/stepper/accel_controller/testcase.yaml
```yaml
# SPDX-FileCopyrightText: Copyright (c) 2026 Navimatix GmbH
# SPDX-License-Identifier: Apache-2.0

common:
  tags:
    - drivers
    - stepper
tests:
  drivers.stepper.accel_controller:
    platform_allow:
      - nucleo_wb55rg
```

## tests/drivers/stepper/stepper_acceleration/testcase.yaml
```yaml
# Copyright (c) 2024 Navimatix GmbH
# SPDX-License-Identifier: Apache-2.0

tests:
  drivers.stepper.stepper_acceleration:
    tags:
      - drivers
      - stepper
      - api
    platform_allow:
      - nucleo_f767zi
      - mimxrt1060_evk@B/mimxrt1062/qspi
      - rpi_pico
    integration_platforms:
      - nucleo_f767zi
      - mimxrt1060_evk@B/mimxrt1062/qspi
      - rpi_pico
```

## tests/drivers/stepper/stepper_api/boards/mimxrt1060_evk_mimxrt1062_qspi_B.conf
```kconfig
CONFIG_BASE_MS_RESOLUTION=1
CONFIG_TEST_MS_RESOLUTION=4
CONFIG_INCORRECT_MS_RESOLUTION=3
CONFIG_SPEED_STEPS=50
```

## tests/drivers/stepper/stepper_api/boards/nucleo_f767zi.conf
```kconfig
CONFIG_BASE_MS_RESOLUTION=1
CONFIG_TEST_MS_RESOLUTION=4
CONFIG_INCORRECT_MS_RESOLUTION=3
CONFIG_SPEED_STEPS=50
CONFIG_STEPPER_STEP_DIR_GENERATE_ISR_SAFE_EVENTS=y
```

## tests/drivers/stepper/stepper_drv8424/testcase.yaml
```yaml
# Copyright (c) 2024 TiaC Systems
# SPDX-License-Identifier: Apache-2.0

tests:
  drivers.stepper.drv8424:
    tags:
      - drivers
      - stepper
      - api
      - drv8424
    platform_allow:
      - nucleo_f767zi
      - mimxrt1060_evkb
```

## tests/drivers/stepper/stepper_drv8424_accel/testcase.yaml
```yaml
# Copyright (c) 2024 Navimatix GmbH
# SPDX-License-Identifier: Apache-2.0

tests:
  drivers.stepper.drv8424_accel:
    tags:
      - drivers
      - stepper
      - api
      - drv8424_accel
    platform_allow:
      - nucleo_f767zi
      - mimxrt1060_evkb
      - native_sim
    integration_platforms:
      - nucleo_f767zi
      - mimxrt1060_evkb
      - native_sim
```

## tests/drivers/stepper/stepper_pos_edge/testcase.yaml
```yaml
# SPDX-FileCopyrightText: Copyright (c) 2024 Navimatix GmbH
# SPDX-License-Identifier: Apache-2.0

tests:
  drivers.stepper.stepper_pos_edge:
    tags:
      - drivers
      - stepper
      - api
    platform_allow:
      - mimxrt1060_evkb
      - nucleo_f767zi
      - rpi_pico
```
