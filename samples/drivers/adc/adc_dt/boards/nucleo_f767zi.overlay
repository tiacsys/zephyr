/*
 * SPDX-License-Identifier: Apache-2.0
 *
 * Copyright (c) 2025 STMicroelectronics
 */

/ {
	zephyr,user {
		/* adjust channel number according to pinmux in board.dts */
		// io-channels = <&adc1 0>, <&adc1 1>, <&adc1 2>, <&adc1 3>, <&adc1 4>;
		io-channels = <&adc1 3>;
	};
};

&adc1 {
	#address-cells = <1>;
	#size-cells = <0>;
	pinctrl-0 = <&adc1_in3_pa3>;
	// status = "okay";

	// channel@0 {
	// 	reg = <0>;
	// 	zephyr,gain = "ADC_GAIN_1";
	// 	zephyr,reference = "ADC_REF_INTERNAL";
	// 	zephyr,acquisition-time = <ADC_ACQ_TIME_DEFAULT>;
	// 	zephyr,resolution = <12>;
	// };

	// channel@1 {
	// 	reg = <1>;
	// 	zephyr,gain = "ADC_GAIN_1";
	// 	zephyr,reference = "ADC_REF_INTERNAL";
	// 	zephyr,acquisition-time = <ADC_ACQ_TIME_DEFAULT>;
	// 	zephyr,resolution = <12>;
	// };

	// channel@2 {
	// 	reg = <2>;
	// 	zephyr,gain = "ADC_GAIN_1";
	// 	zephyr,reference = "ADC_REF_INTERNAL";
	// 	zephyr,acquisition-time = <ADC_ACQ_TIME_DEFAULT>;
	// 	zephyr,resolution = <12>;
	// };

	channel@3 {
		reg = <3>;
		zephyr,gain = "ADC_GAIN_1";
		zephyr,reference = "ADC_REF_INTERNAL";
		zephyr,acquisition-time = <ADC_ACQ_TIME_DEFAULT>;
		zephyr,resolution = <12>;
	};

	// channel@4 {
	// 	reg = <4>;
	// 	zephyr,gain = "ADC_GAIN_1";
	// 	zephyr,reference = "ADC_REF_INTERNAL";
	// 	zephyr,acquisition-time = <ADC_ACQ_TIME_DEFAULT>;
	// 	zephyr,resolution = <12>;
	// };

	// channel@10 {
	// 	reg = <10>;
	// 	zephyr,gain = "ADC_GAIN_1";
	// 	zephyr,reference = "ADC_REF_INTERNAL";
	// 	zephyr,acquisition-time = <ADC_ACQ_TIME_DEFAULT>;
	// 	zephyr,resolution = <12>;
	// };
};
