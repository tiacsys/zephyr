/*
 * Copyright (c) 2024 Navimatix GmbH
 *
 * SPDX-License-Identifier: Apache-2.0
 */

/ {

	counter1: counter{
		status = "okay";
		compatible = "zephyr,counter-emul";

	};
	counter2: counter2{
		status = "okay";
		compatible = "zephyr,counter-emul";
		counting-down;

	};

};
